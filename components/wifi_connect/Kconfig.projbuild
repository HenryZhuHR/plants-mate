## components/wifi_connect/Kconfig.projbuild
```kconfig
menu "Example Configuration"

    config ESP_WIFI_SSID
        string "WiFi SSID"
        default "207_Inner"
        help
            SSID (network name) for the example to connect to.
            "207_Inner"
            "Thinkee"

    config ESP_WIFI_PASSWORD
        string "WiFi Password"
        default "eis207207"
        help
            WiFi password (WPA or WPA2) for the example to use.
            "eis207207"
            "20210618"
            

    config ESP_MAXIMUM_RETRY
        int "Maximum retry"
        default 5
        help
            Set the Maximum retry to avoid station reconnecting to the AP unlimited when the AP is really inexistent.

    choice ESP_WIFI_SCAN_AUTH_MODE_THRESHOLD
        prompt "WiFi Scan auth mode threshold"
        default ESP_WIFI_AUTH_WPA2_PSK
        help
            The weakest authmode to accept in the scan mode.

        config ESP_WIFI_AUTH_OPEN
            bool "OPEN"
        config ESP_WIFI_AUTH_WEP
            bool "WEP"
        config ESP_WIFI_AUTH_WPA_PSK
            bool "WPA PSK"
        config ESP_WIFI_AUTH_WPA2_PSK
            bool "WPA2 PSK"
        config ESP_WIFI_AUTH_WPA_WPA2_PSK
            bool "WPA/WPA2 PSK"
        config ESP_WIFI_AUTH_WPA3_PSK
            bool "WPA3 PSK"
        config ESP_WIFI_AUTH_WPA2_WPA3_PSK
            bool "WPA2/WPA3 PSK"
        config ESP_WIFI_AUTH_WAPI_PSK
            bool "WAPI PSK"
    endchoice



    choice SNTP_TIME_SYNC_METHOD
        prompt "Time synchronization method"
        default SNTP_TIME_SYNC_METHOD_IMMED
        help
            Time synchronization method.

        config SNTP_TIME_SYNC_METHOD_IMMED
            bool "update time immediately when received"
        config SNTP_TIME_SYNC_METHOD_SMOOTH
            bool "update time with smooth method (adjtime)"
        config SNTP_TIME_SYNC_METHOD_CUSTOM
            bool "custom implementation"
    endchoice




    config EXAMPLE_CONNECT_IPV6
        bool "Obtain IPv6 address"
        default y
        depends on EXAMPLE_CONNECT_WIFI || EXAMPLE_CONNECT_ETHERNET
        select LWIP_IPV6
        help
            By default, examples will wait until IPv4 and IPv6 local link addresses are obtained.
            Disable this option if the network does not support IPv6.
            Choose the preferred IPv6 address type if the connection code should wait until other than
            the local link address gets assigned.
            Consider enabling IPv6 stateless address autoconfiguration (SLAAC) in the LWIP component.

    if EXAMPLE_CONNECT_IPV6
        choice EXAMPLE_CONNECT_PREFERRED_IPV6
            prompt "Preferred IPv6 Type"
            default EXAMPLE_CONNECT_IPV6_PREF_LOCAL_LINK
            help
                Select which kind of IPv6 address the connect logic waits for.

            config EXAMPLE_CONNECT_IPV6_PREF_LOCAL_LINK
                bool "Local Link Address"
                help
                    Blocks until Local link address assigned.

            config EXAMPLE_CONNECT_IPV6_PREF_GLOBAL
                bool "Global Address"
                help
                    Blocks until Global address assigned.

            config EXAMPLE_CONNECT_IPV6_PREF_SITE_LOCAL
                bool "Site Local Address"
                help
                    Blocks until Site link address assigned.

            config EXAMPLE_CONNECT_IPV6_PREF_UNIQUE_LOCAL
                bool "Unique Local Link Address"
                help
                    Blocks until Unique local address assigned.

        endchoice

    endif

    

endmenu
```

## eps32/components/mqtt_client_package/Kconfig.projbuild
```kconfig
menu "Example Configuration"

    config MQTT_BROKER_URL
        string "mqtt Broker URL"
        default "mqtt://henryzhuhr.xyz"

    config MQTT_BROKER_PORT
        int "mqtt Broker port"
        default 1885
    
    config MQTT_CLIENT_USERNAME
        string "mqtt client username"
        default "plantsmate"

    config MQTT_CLIENT_PASSEORD
        string "mqtt client password"
        default "20221018"

    config MQTT_CLIENT_TOPIC
        string "mqtt client topic"
        default "plantsmate"
        
    config MQTT_CLIENT_QOS
        int "mqtt client qos"
        default 0


endmenu
```
